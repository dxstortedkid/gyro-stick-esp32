## west-manifest/west.yml
```yaml
manifest:
  self:
    path: gyro-stick-esp32

  remotes:
    - name: zephyrproject
      url-base: https://github.com/zephyrproject-rtos

  projects:
    - name: zephyr
      repo-path: zephyr
      remote: zephyrproject
      revision: v4.4.0
      clone-depth: 1
      import:
        name-allowlist:
          - hal_espressif
          - picolibc
          - segger
```
